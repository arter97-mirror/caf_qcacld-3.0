## configs/autoghgvm_gki_qcn7605_defconfig
```kconfig
CONFIG_QCA_CLD_WLAN=y
CONFIG_CFG80211_MLO_KEY_OPERATION_SUPPORT=y
CONFIG_CFG80211_LINK_STA_PARAMS_PRESENT=y
CONFIG_NL80211_EXT_FEATURE_PUNCT_SUPPORT=y
CONFIG_CFG80211_RU_PUNCT_NOTIFY=y
CONFIG_CFG80211_EXT_FEATURE_AUTH_AND_DEAUTH_RANDOM_TA=y
CONFIG_CFG80211_EXTERNAL_AUTH_MLO_SUPPORT=y
CONFIG_CFG80211_EXT_FEATURE_SECURE_NAN=y
CONFIG_CFG80211_MLD_AP_STA_CONNECT_UPSTREAM_SUPPORT=y
CONFIG_PTT_SOCK_SVC_ENABLE=y
CONFIG_FEATURE_WLAN_WAPI=y
CONFIG_SOFTAP_CHANNEL_RANGE=y
CONFIG_FEATURE_WLAN_SCAN_PNO=y
CONFIG_WLAN_FEATURE_PACKET_FILTERING=y
CONFIG_WLAN_NS_OFFLOAD=y
CONFIG_QCA_TARGET_IF_MLME=y
CONFIG_FEATURE_WLAN_RA_FILTERING=y
CONFIG_FEATURE_WLAN_LPHB=y
CONFIG_QCA_SUPPORT_TX_THROTTLE=y
CONFIG_QCA_SUPPORT_TX_THROTTLE_LEGACY=y
CONFIG_WMI_INTERFACE_EVENT_LOGGING=y
CONFIG_WLAN_FEATURE_LINK_LAYER_STATS=y
CONFIG_WLAN_FEATURE_MIB_STATS=y
CONFIG_160MHZ_SUPPORT=y
CONFIG_REG_CLIENT=y
CONFIG_WLAN_PMO_ENABLE=y
CONFIG_CONVERGED_P2P_ENABLE=y
CONFIG_WLAN_POLICY_MGR_ENABLE=y
CONFIG_FEATURE_DENYLIST_MGR=y
CONFIG_SUPPORT_11AX=y
CONFIG_HDD_INIT_WITH_RTNL_LOCK=y
CONFIG_WMI_CMD_STRINGS=y
#CONFIG_WLAN_FEATURE_TWT=y
#CONFIG_WLAN_TWT_CONVERGED=y
CONFIG_WLAN_DISABLE_EXPORT_SYMBOL=y
CONFIG_WIFI_POS_CONVERGED=y
CONFIG_FEATURE_HTC_CREDIT_HISTORY=y
#CONFIG_WLAN_WEXT_SUPPORT_ENABLE=y
CONFIG_WLAN_LOGGING_SOCK_SVC=y
CONFIG_WLAN_LOGGING_BUFFERS_DYNAMICALLY=y
CONFIG_WLAN_FEATURE_FILS=y
CONFIG_CP_STATS=y
CONFIG_FEATURE_MEMDUMP_ENABLE=y
CONFIG_FEATURE_FW_LOG_PARSING=y
CONFIG_WLAN_FW_OFFLOAD=y
CONFIG_FEATURE_COEX=y
CONFIG_PLD_PCIE_CNSS_FLAG=y
CONFIG_PLD_PCIE_INIT_FLAG=y
CONFIG_FEATURE_MONITOR_LEGACY_MODE_SUPPORT=y
CONFIG_FEATURE_MONITOR_MODE_SUPPORT=y
CONFIG_WLAN_NAPI=y
CONFIG_WLAN_DP_LEGACY_OL_RX_THREAD=y
CONFIG_WIFI_3_0_ADRASTEA=y
CONFIG_ADRASTEA_SHADOW_REGISTERS=y
CONFIG_ADRASTEA_RRI_ON_DDR=y
CONFIG_WLAN_FASTPATH=y
CONFIG_FEATURE_PKTLOG=y
#CONFIG_PKTLOG_LEGACY=y
CONFIG_CNSS_OUT_OF_TREE=y
CONFIG_WLAN_FEATURE_DP_BUS_BANDWIDTH=y
CONFIG_WLAN_TX_FLOW_CONTROL=y
CONFIG_WLAN_DEBUG_VERSION=y
CONFIG_QCOM_VOWIFI_11R=y
#CONFIG_WLAN_DEBUG_CRASH_INJECT=y
CONFIG_QCOM_TDLS=y
CONFIG_QCACLD_WLAN_LFR2=y
CONFIG_CNSS_GENL=y
CONFIG_CNSS_UTILS=y
CONFIG_WLAN_FEATURE_SAE=y
CONFIG_PANIC_ON_BUG=y
CONFIG_WLAN_WARN_ON_ASSERT=y
CONFIG_POWER_MANAGEMENT_OFFLOAD=y
CONFIG_WLAN_LOG_FATAL=y
CONFIG_WLAN_LOG_ERROR=y
CONFIG_WLAN_LOG_WARN=y
CONFIG_WLAN_LOG_INFO=y
CONFIG_WLAN_LOG_DEBUG=y
CONFIG_WLAN_LOG_ENTER=y
CONFIG_WLAN_LOG_EXIT=y
CONFIG_WLAN_OPEN_SOURCE=y
CONFIG_QCACLD_FEATURE_NAN=y
CONFIG_RX_PERFORMANCE=y
CONFIG_ATH_PERF_PWR_OFFLOAD=y
CONFIG_REMOVE_PKT_LOG=y
CONFIG_ATH_11AC_TXCOMPACT=y
CONFIG_HIF_PCI=y
CONFIG_LL_DP_SUPPORT=y
CONFIG_LL_DP_LEGACY_SUPPORT=y
CONFIG_WLAN_FEATURE_GET_USABLE_CHAN_LIST=y
CONFIG_WLAN_REG_AUTO=y
CONFIG_LITTLE_ENDIAN=y
CONFIG_QCA_WIFI_FTM=y
CONFIG_LINUX_QCMBR=y
CONFIG_CHECKSUM_OFFLOAD=y
#CONFIG_WDI3_IPA_OVER_GSI=y
CONFIG_WLAN_OPEN_P2P_INTERFACE=y
CONFIG_WMI_BCN_OFFLOAD=y
CONFIG_GTK_OFFLOAD=y
CONFIG_SMP=y
CONFIG_RPS=y
CONFIG_WLAN_ENABLE_SOCIAL_CHANNELS_5G_ONLY=y
CONFIG_QCACLD_FEATURE_APF=y
CONFIG_FEATURE_WLAN_FT_IEEE8021X=y
CONFIG_FEATURE_WLAN_FT_PSK=y
CONFIG_HOST_11D_SCAN=y
CONFIG_TARGET_RAMDUMP_AFTER_KERNEL_PANIC=y
CONFIG_WLAN_SYNC_TSF_PLUS_DISABLE_SOCK_TS=y
CONFIG_ATH_PROCFS_DIAG_SUPPORT=y
CONFIG_RX_OL=y
CONFIG_AR900B=y
CONFIG_HTT_PADDR64=y
CONFIG_OL_RX_INDICATION_RECORD=y
CONFIG_FEATURE_TSO=y
CONFIG_FEATURE_TSO_DEBUG=y
CONFIG_TSOSEG_DEBUG=y
CONFIG_ENABLE_DEBUG_ADDRESS_MARKING=y
CONFIG_FEATURE_EPPING=y
CONFIG_WLAN_OFFLOAD_PACKETS=y
CONFIG_WLAN_FEATURE_FIPS=y
CONFIG_LFR_SUBNET_DETECTION=y
CONFIG_MCC_TO_SCC_SWITCH=y
CONFIG_HELIUMPLUS=y
CONFIG_QCN7605_SUPPORT=y
CONFIG_DP_TRACE=y
CONFIG_HIF_REG_WINDOW_SUPPORT=y
CONFIG_WLAN_ALLOCATE_GLOBAL_BUFFERS_DYNAMICALLY=y
CONFIG_IPA_DISABLE_OVERRIDE=y
CONFIG_QCA_LL_TX_FLOW_CONTROL_RESIZE=y
CONFIG_TX_AGGREGATION_SIZE_ENABLE=y
CONFIG_FEATURE_STATION_INFO=y
CONFIG_FEATURE_SAR_LIMITS=y
CONFIG_WMI_ROAM_SUPPORT=y
CONFIG_WMI_CONCURRENCY_SUPPORT=y
CONFIG_WMI_STA_SUPPORT=y
CONFIG_WLAN_DFS_STATIC_MEM_ALLOC=y
CONFIG_WLAN_FEATURE_DFS_OFFLOAD=y
CONFIG_WLAN_DFS_MASTER_ENABLE=y
CONFIG_WLAN_DEBUGFS=y
CONFIG_FW_THERMAL_THROTTLE=y
CONFIG_HOST_OPCLASS=y
CONFIG_TARGET_11D_SCAN=y
CONFIG_QCACLD_FEATURE_BTC_CHAIN_MODE=y
CONFIG_NUM_SOC_PERF_CLUSTER=1
CONFIG_CFG_PMO_WOW_FILTERS_MAX=16
CONFIG_CFG_GTK_OFFLOAD_MAX_VDEV=2
CONFIG_CFG_ROAM_OFFLOAD_MAX_VDEV=1
CONFIG_CFG_MAX_PERIODIC_TX_PTRNS=3
CONFIG_CFG_MAX_STA_VDEVS=2
CONFIG_CFG_NUM_OF_ADDITIONAL_FW_PEERS=0
CONFIG_CFG_NUM_OF_TDLS_CONN_TABLE_ENTRIES=4
CONFIG_CFG_BMISS_OFFLOAD_MAX_VDEV=3
CONFIG_WLAN_MAX_VDEVS=5
CONFIG_WLAN_SER_MAX_PENDING_CMDS_AP=10
CONFIG_WLAN_PDEV_MAX_VDEVS=5
CONFIG_WLAN_PSOC_MAX_VDEVS=5
CONFIG_SIR_SAP_MAX_NUM_PEERS=10
CONFIG_BEACON_TX_OFFLOAD_MAX_VDEV=3
CONFIG_HIF_CPU_PERF_AFFINE_MASK=y
CONFIG_WALT_GET_CPU_TAKEN_SUPPORT=y
CONFIG_GET_DRIVER_MODE=y
CONFIG_SHUTDOWN_WLAN_IN_SYSTEM_SUSPEND=y
CONFIG_MULTI_IF_NAME="qcn7605"
CONFIG_WLAN_HOST_ARCH_ARM=y
CONFIG_WLAN_CTRL_NAME="wlan"
```

## configs/autogvm_consolidate_kiwi-v2_cnss2_defconfig
```kconfig
CONFIG_FEATURE_ROAM_DEBUG=y
CONFIG_TRACE_RECORD_FEATURE=y
CONFIG_WLAN_FEATURE_P2P_DEBUG=y
CONFIG_ENABLE_MTRACE_LOG=y
CONFIG_WLAN_NUD_TRACKING=y
CONFIG_UNIT_TEST=y
CONFIG_QDF_TEST=y
CONFIG_DESC_DUP_DETECT_DEBUG=y
```
