## configs/sdxkova_gki_kiwi-v2_defconfig
```kconfig
CONFIG_QCA_CLD_WLAN=y
CONFIG_160MHZ_SUPPORT=y
CONFIG_6G_SCAN_CHAN_SORT_ALGO=y
CONFIG_ADAPTIVE_11R=y
CONFIG_AFC_SUPPORT=y
CONFIG_ANI_LEVEL_REQUEST=y
CONFIG_AR900B=y
CONFIG_ATH_11AC_TXCOMPACT=y
CONFIG_ATH_BUS_PM=y
CONFIG_ATH_PERF_PWR_OFFLOAD=y
CONFIG_BAND_6GHZ=y
CONFIG_BCN_RATECODE_ENABLE=y
CONFIG_BEACON_TX_OFFLOAD_MAX_VDEV=6
CONFIG_BERYLLIUM=y
CONFIG_BUILD_TAG=y
CONFIG_BYPASS_WDS_OL_OPS=y
CONFIG_CE_DISABLE_SRNG_TIMER_IRQ=y
CONFIG_CFG_BMISS_OFFLOAD_MAX_VDEV=4
CONFIG_CFG_MAX_STA_VDEVS=4
CONFIG_CFG80211_MLD_AP_STA_CONNECT_UPSTREAM_SUPPORT=y
CONFIG_CHANNEL_HOPPING_ALL_BANDS=y
CONFIG_CHECKSUM_OFFLOAD=y
CONFIG_CHIP_VERSION=2
CONFIG_CNSS_GENL_MODULE=y
CONFIG_CNSS_KIWI=y
CONFIG_CNSS_KIWI_V2=y
CONFIG_CNSS_UTILS=y
CONFIG_CNSS_UTILS_MODULE=y
CONFIG_CONNECTIVITY_PKTLOG=y
CONFIG_CONVERGED_P2P_ENABLE=y
CONFIG_CP_STATS=y
CONFIG_DCS=y
CONFIG_DDP_MON_RSSI_IN_DBM=y
CONFIG_DEBUG_RX_RING_BUFFER=y
CONFIG_DELIVERY_TO_STACK_STATUS_CHECK=y
CONFIG_DESC_DUP_DETECT_DEBUG=y
CONFIG_DEVICE_FORCE_WAKE_ENABLE=y
CONFIG_DIRECT_BUF_RX_ENABLE=y
CONFIG_DISABLE_CHANNEL_LIST=y
CONFIG_DISABLE_EAPOL_INTRABSS_FWD=y
CONFIG_DISABLE_STATUS_RING_TIMER_WAR=y
CONFIG_DP_BE_WAR=y
CONFIG_DP_CON_MON_MSI_ENABLED=y
CONFIG_DP_CON_MON_MSI_SKIP_SET=y
CONFIG_DP_FTM_MODE_SKIP_WBM_RING_INIT=y
CONFIG_DP_HW_TX_DELAY_STATS_ENABLE=y
CONFIG_DP_INTR_POLL_BASED=y
CONFIG_DP_LFR=y
CONFIG_DP_MLO_LINK_STATS_SUPPORT=y
CONFIG_DP_MULTIPASS_SUPPORT=y
CONFIG_DP_PKT_STATS_PER_LMAC=y
CONFIG_DP_RX_BUFFER_POOL_ALLOC_THRES=5
CONFIG_DP_RX_BUFFER_POOL_SIZE=128
CONFIG_DP_RX_DROP_RAW_FRM=y
CONFIG_DP_RX_MSDU_DONE_FAIL_HISTORY=y
CONFIG_DP_RX_PEEK_MSDU_DONE_WAR=y
CONFIG_DP_RX_PKT_NO_PEER_DELIVER=y
CONFIG_DP_RX_REFILL_BUFF_POOL_SIZE=256
CONFIG_DP_RX_REFILL_THRD_THRESHOLD=128
CONFIG_DP_RX_SPECIAL_FRAME_NEED=y
CONFIG_DP_TRACE=y
CONFIG_DP_TRAFFIC_END_INDICATION=y
CONFIG_DP_TXRX_SOC_ATTACH=y
CONFIG_DP_TX_PACKET_INSPECT_FOR_ILP=y
CONFIG_DP_USE_REDUCED_PEER_ID_FIELD_WIDTH=y
CONFIG_DP_WAR_INVALID_FIRST_MSDU_FLAG=y
CONFIG_DUP_RX_DESC_WAR=y
CONFIG_DYNAMIC_RX_AGGREGATION=y
CONFIG_EMULATION_2_0=y
CONFIG_ENABLE_HAL_REG_WR_HISTORY=y
CONFIG_ENABLE_HAL_SOC_STATS=y
CONFIG_ENABLE_MTRACE_LOG=y
CONFIG_ENABLE_SMMU_S1_TRANSLATION=y
CONFIG_FEATURE_ACTIVE_TOS=y
CONFIG_FEATURE_ALIGN_STATS_FROM_DP=y
CONFIG_FEATURE_AP_MCC_CH_AVOIDANCE=y
CONFIG_FEATURE_BSS_TRANSITION=y
CONFIG_FEATURE_BUS_BANDWIDTH_MGR=y
CONFIG_FEATURE_CLUB_LL_STATS_AND_GET_STATION=y
CONFIG_FEATURE_COEX=y
CONFIG_FEATURE_CONCURRENCY_MATRIX=y
CONFIG_FEATURE_DELAYED_PEER_OBJ_DESTROY=y
CONFIG_FEATURE_DENYLIST_MGR=y
CONFIG_FEATURE_FORCE_WAKE=y
CONFIG_FEATURE_FW_LOG_PARSING=y
CONFIG_FEATURE_GPIO_CFG=y
CONFIG_FEATURE_HTC_CREDIT_HISTORY=y
CONFIG_FEATURE_INTEROP_ISSUES_AP=y
CONFIG_FEATURE_MCL_REPEATER=y
CONFIG_FEATURE_MEC=y
CONFIG_FEATURE_MEMDUMP_ENABLE=y
CONFIG_FEATURE_MONITOR_MODE_SUPPORT=y
CONFIG_FEATURE_MSCS=y
CONFIG_FEATURE_NO_DBS_INTRABAND_MCC_SUPPORT=y
CONFIG_FEATURE_OEM_DATA=y
CONFIG_FEATURE_OTA_TEST=y
CONFIG_FEATURE_RADAR_HISTORY=y
CONFIG_FEATURE_ROAM_DEBUG=y
CONFIG_FEATURE_RSSI_MONITOR=y
CONFIG_FEATURE_RX_LINKSPEED_ROAM_TRIGGER=y
CONFIG_FEATURE_SAP_COND_CHAN_SWITCH=y
CONFIG_FEATURE_SAR_LIMITS=y
CONFIG_FEATURE_SET=y
CONFIG_FEATURE_SMEM_MAILBOX=y
CONFIG_FEATURE_STATION_INFO=y
CONFIG_FEATURE_STATS_EXT=y
CONFIG_FEATURE_STATS_EXT_V2=y
CONFIG_FEATURE_STA_MODE_VOTE_LINK=y
CONFIG_FEATURE_TSO=y
CONFIG_FEATURE_TSO_STATS=y
CONFIG_FEATURE_TX_POWER=y
CONFIG_FEATURE_VDEV_OPS_WAKELOCK=y
CONFIG_FEATURE_WDS=y
CONFIG_FEATURE_WLAN_AP_AP_ACS_OPTIMIZE=y
CONFIG_FEATURE_WLAN_AUTO_SHUTDOWN=y
CONFIG_FEATURE_WLAN_CH_AVOID_EXT=y
CONFIG_FEATURE_WLAN_D0WOW=y
CONFIG_FEATURE_WLAN_DNW=y
CONFIG_FEATURE_WLAN_LPHB=y
CONFIG_FEATURE_WLAN_MCC_TO_SCC_SWITCH=y
CONFIG_FEATURE_WLAN_PRE_CAC=y
CONFIG_FEATURE_WLAN_RA_FILTERING=y
CONFIG_FEATURE_WLAN_SCAN_PNO=y
CONFIG_FEATURE_WLAN_STA_4ADDR_SCHEME=y
CONFIG_FEATURE_WLAN_SUPPORT_USD=y
CONFIG_FEATURE_WLAN_WAPI=y
CONFIG_FIFTH_CONNECTION=y
CONFIG_FIX_TXDMA_LIMITATION=y
CONFIG_FOURTH_CONNECTION=y
CONFIG_FW_THERMAL_THROTTLE=y
CONFIG_GET_DRIVER_MODE=y
CONFIG_GTK_OFFLOAD=y
CONFIG_HAL_DISABLE_NON_BA_2K_JUMP_ERROR=y
CONFIG_HANDLE_BC_EAP_TX_FRM=y
CONFIG_HANDLE_RX_REROUTE_ERR=y
CONFIG_HASTINGS_BT_WAR=y
CONFIG_HDD_INIT_WITH_RTNL_LOCK=y
CONFIG_HIF_DEBUG=y
CONFIG_HIF_PCI=y
CONFIG_HIF_REG_WINDOW_SUPPORT=y
CONFIG_HOST_OPCLASS=y
CONFIG_HTT_PADDR64=y
CONFIG_INCLUDE_HAL_KIWI=y
CONFIG_IPA_HANDLE_MLO_DEF_LINK_REG=y
CONFIG_IPA_OFFLOAD=y
CONFIG_IPA_SET_RESET_TX_DB_PA=y
CONFIG_IPA_WDI3_TX_TWO_PIPES=y
CONFIG_IPA_WDI3_VLAN_SUPPORT=y
CONFIG_IPA_WDS_EASYMESH=y
CONFIG_KIWI_HEADERS_DEF=y
CONFIG_LFR_SUBNET_DETECTION=y
CONFIG_LINUX_QCMBR=y
CONFIG_LITTLE_ENDIAN=y
CONFIG_LL_DP_SUPPORT=y
CONFIG_LTE_COEX=y
CONFIG_MARK_ICMP_REQ_TO_FW=y
CONFIG_MAX_ALLOC_PAGE_SIZE=y
CONFIG_MAX_CLIENTS_ALLOWED=64
CONFIG_MCC_TO_SCC_SWITCH=y
CONFIG_MDM_PLATFORM=y
CONFIG_MOBILE_ROUTER=y
CONFIG_MONITOR_MODULARIZED_ENABLE=y
CONFIG_MON_ENABLE_DROP_FOR_MAC=y
CONFIG_MON_ENABLE_DROP_FOR_NON_MON_PMAC=y
CONFIG_MULTI_CLIENT_LL_SUPPORT=y
CONFIG_NO_RX_PKT_HDR_TLV=y
CONFIG_NUM_IPA_IFACE=6
CONFIG_NUM_SOC_PERF_CLUSTER=1
CONFIG_OBSS_PD=y
CONFIG_OFDM_SCRAMBLER_SEED=y
CONFIG_PCIE_GEN_SWITCH=y
CONFIG_PCI_LINK_STATUS_SANITY=y
CONFIG_PEER_PROTECTED_ACCESS=y
CONFIG_PKTLOG_HAS_SPECIFIC_DATA=y
CONFIG_PLD_PCIE_CNSS_FLAG=y
CONFIG_PLD_PCIE_INIT_FLAG=y
CONFIG_POWER_MANAGEMENT_OFFLOAD=y
CONFIG_PTT_SOCK_SVC_ENABLE=y
CONFIG_QCACLD_FEATURE_APF=y
CONFIG_QCACLD_FEATURE_FW_STATE=y
CONFIG_QCACLD_FEATURE_GAP_LL_PS_MODE=y
CONFIG_QCACLD_FEATURE_GREEN_AP=y
CONFIG_QCACLD_FEATURE_SON=y
CONFIG_QCACLD_RX_DESC_MULTI_PAGE_ALLOC=y
CONFIG_QCACLD_WLAN_CONNECTIVITY_DIAG_EVENT=y
CONFIG_QCACLD_WLAN_LFR3=y
CONFIG_QCA_DFS_BW_PUNCTURE=y
CONFIG_QCA_GET_TSF_VIA_REG=y
CONFIG_QCA_SUPPORT_TX_MIN_RATES_FOR_SPECIAL_FRAMES=y
CONFIG_QCA_SUPPORT_TX_THROTTLE=y
CONFIG_QCA_TARGET_IF_MLME=y
CONFIG_QCA_WIFI_FTM=y
CONFIG_QCA_WIFI_KIWI=y
CONFIG_QCA_WIFI_MONITOR_MODE_NO_MSDU_START_TLV_SUPPORT=y
CONFIG_QCA_WIFI_QCA8074=y
CONFIG_QCA_WIFI_QCA8074_VP=y
CONFIG_QCOM_LTE_COEX=y
CONFIG_QCOM_VOWIFI_11R=y
CONFIG_QDF_MAX_NO_OF_SAP_MODE=6
CONFIG_QMI_SUPPORT=y
CONFIG_REG_CLIENT=y
CONFIG_REMOVE_PKT_LOG=y
CONFIG_REO_DESC_DEFER_FREE=y
CONFIG_ROME_IF="pci"
CONFIG_RXDMA_ERR_PKT_DROP=y
CONFIG_RX_DEFRAG_DO_NOT_REINJECT=y
CONFIG_RX_DESC_SANITY_WAR=y
CONFIG_RX_FISA=y
CONFIG_RX_HASH_DEBUG=y
CONFIG_RX_OL=y
CONFIG_SAE_SINGLE_PMK=y
CONFIG_SAP_AVOID_ACS_FREQ_LIST=y
CONFIG_SAP_DHCP_FW_IND=y
CONFIG_SAP_UNSAFE_FIXED_CHAN_ALLOW=y
CONFIG_SAR_SAFETY_FEATURE=y
CONFIG_SCALE_INCLUDES=y
CONFIG_SERIALIZE_QUEUE_SETUP=y
CONFIG_SHADOW_V3=y
CONFIG_SIXTH_CONNECTION=y
CONFIG_SMMU_S1_UNMAP=y
CONFIG_SOFTAP_CHANNEL_RANGE=y
CONFIG_SUPPORT_11AX=y
CONFIG_SYSTEM_PM_CHECK=y
CONFIG_TARGET_11D_SCAN=y
CONFIG_TARGET_RAMDUMP_AFTER_KERNEL_PANIC=y
CONFIG_TRACE_RECORD_FEATURE=y
CONFIG_TSO_DEBUG_LOG_ENABLE=y
CONFIG_TX_ADDR_INDEX_SEARCH=y
CONFIG_TX_MULTIQ_PER_AC=y
CONFIG_TX_MULTI_TCL=y
CONFIG_TX_PER_PDEV_DESC_POOL=y
CONFIG_TX_TID_OVERRIDE=y
CONFIG_VERBOSE_DEBUG=y
CONFIG_WAPI_BIG_ENDIAN=y
CONFIG_WCNSS_MEM_PRE_ALLOC=y
CONFIG_WCNSS_MEM_PRE_ALLOC_MODULE=y
CONFIG_WDI3_IPA_OVER_GSI=y
CONFIG_WDI_EVENT_ENABLE=y
CONFIG_WDS_CONV_TARGET_IF_OPS_ENABLE=y
CONFIG_WIFI_POS_CONVERGED=y
CONFIG_WIFI_POS_PASN=y
CONFIG_WINDOW_REG_PLD_LOCK_ENABLE=y
CONFIG_WLAN_BCN_RECV_FEATURE=y
CONFIG_WLAN_CE_INTERRUPT_THRESHOLD_CONFIG=y
CONFIG_WLAN_CLD_DEV_PM_QOS=y
CONFIG_WLAN_CLD_PM_QOS=y
CONFIG_WLAN_CONV_SPECTRAL_ENABLE=y
CONFIG_WLAN_CUSTOM_DSCP_UP_MAP=y
CONFIG_WLAN_DEBUGFS=y
CONFIG_WLAN_DEBUG_CRASH_INJECT=y
CONFIG_WLAN_DEBUG_LINK_VOTE=y
CONFIG_WLAN_DEBUG_VERSION=y
CONFIG_WLAN_DFS_MASTER_ENABLE=y
CONFIG_WLAN_DFS_STATIC_MEM_ALLOC=y
CONFIG_WLAN_DIAG_VERSION=y
CONFIG_WLAN_DL_MODES=y
CONFIG_WLAN_DP_DISABLE_TCL_CMD_CRED_SRNG=y
CONFIG_WLAN_DP_DISABLE_TCL_STATUS_SRNG=y
CONFIG_WLAN_DP_FEATURE_DEFERRED_REO_QDESC_DESTROY=y
CONFIG_WLAN_DP_PENDING_MEM_FLUSH=y
CONFIG_WLAN_DP_PER_RING_TYPE_CONFIG=y
CONFIG_WLAN_DP_SRNG_USAGE_WM_TRACKING=y
CONFIG_WLAN_DP_VDEV_NO_SELF_PEER=y
CONFIG_WLAN_DYNAMIC_CVM=y
CONFIG_WLAN_FEATURE_11AX=y
CONFIG_WLAN_FEATURE_11BE=y
CONFIG_WLAN_FEATURE_11BE_MLO=y
CONFIG_WLAN_FEATURE_ACTION_OUI=y
CONFIG_WLAN_FEATURE_AFC_DCS_SKIP_ACS_RANGE=y
CONFIG_WLAN_FEATURE_AFFINITY_MGR=y
CONFIG_WLAN_FEATURE_BIG_DATA_STATS=y
CONFIG_WLAN_FEATURE_CAL_FAILURE_TRIGGER=y
CONFIG_WLAN_FEATURE_CHECK_RSN_BIP=y
CONFIG_WLAN_FEATURE_COEX_DBAM=y
CONFIG_WLAN_FEATURE_DFS_OFFLOAD=y
CONFIG_WLAN_FEATURE_DISA=y
CONFIG_WLAN_FEATURE_DP_BUS_BANDWIDTH=y
CONFIG_WLAN_FEATURE_DP_EVENT_HISTORY=y
CONFIG_WLAN_FEATURE_DP_RX_THREADS=y
CONFIG_WLAN_FEATURE_DYNAMIC_MAC_ADDR_UPDATE=y
CONFIG_WLAN_FEATURE_ELNA=y
CONFIG_WLAN_FEATURE_FILS=y
CONFIG_WLAN_FEATURE_FIPS=y
CONFIG_WLAN_FEATURE_GET_USABLE_CHAN_LIST=y
CONFIG_WLAN_FEATURE_ICMP_OFFLOAD=y
CONFIG_WLAN_FEATURE_IGMP_OFFLOAD=y
CONFIG_WLAN_FEATURE_LINK_LAYER_STATS=y
CONFIG_WLAN_FEATURE_LL_LT_SAP=y
CONFIG_WLAN_FEATURE_LRO_CTX_IN_CB=y
CONFIG_WLAN_FEATURE_MARK_FIRST_WAKEUP_PACKET=y
CONFIG_WLAN_FEATURE_MBSSID=y
CONFIG_WLAN_FEATURE_MC_BC_4_ADDR=y
CONFIG_WLAN_FEATURE_MCC_QUOTA=y
CONFIG_WLAN_FEATURE_MDNS_OFFLOAD=y
CONFIG_WLAN_FEATURE_MEDIUM_ASSESS=y
CONFIG_WLAN_FEATURE_MIB_STATS=y
CONFIG_WLAN_FEATURE_MULTI_LINK_SAP=y
CONFIG_WLAN_FEATURE_MULTI_LINK_SAP_TEST_CONFIG=y
CONFIG_WLAN_FEATURE_NEAR_FULL_IRQ=y
CONFIG_WLAN_FEATURE_P2P_DEBUG=y
CONFIG_WLAN_FEATURE_P2P_P2P_STA=y
CONFIG_WLAN_FEATURE_PACKET_FILTERING=y
CONFIG_WLAN_FEATURE_PEER_TXQ_FLUSH_CONF=y
CONFIG_WLAN_FEATURE_ROAM_INFO_STATS=y
CONFIG_WLAN_FEATURE_RX_BUFFER_POOL=y
CONFIG_WLAN_FEATURE_RX_SOFTIRQ_TIME_LIMIT=y
CONFIG_WLAN_FEATURE_SAE=y
CONFIG_WLAN_FEATURE_SAP_ACS_OPTIMIZE=y
CONFIG_WLAN_FEATURE_SARV1_TO_SARV2=y
CONFIG_WLAN_FEATURE_SR=y
CONFIG_WLAN_FEATURE_TWT=y
CONFIG_WLAN_FEATURE_WMI_DIAG_OVER_CE7=y
CONFIG_WLAN_FW_OFFLOAD=y
CONFIG_WLAN_GTX_BW_MASK=y
CONFIG_WLAN_HANG_EVENT=y
CONFIG_WLAN_HDD_MULTI_VDEV_SINGLE_NDEV=y
CONFIG_WLAN_LOGGING_SOCK_SVC=y
CONFIG_WLAN_LOG_DEBUG=y
CONFIG_WLAN_LOG_ENTER=y
CONFIG_WLAN_LOG_ERROR=y
CONFIG_WLAN_LOG_EXIT=y
CONFIG_WLAN_LOG_FATAL=y
CONFIG_WLAN_LOG_INFO=y
CONFIG_WLAN_LOG_WARN=y
CONFIG_WLAN_MWS_INFO_DEBUGFS=y
CONFIG_WLAN_NAPI=y
CONFIG_WLAN_NS_OFFLOAD=y
CONFIG_WLAN_NUD_TRACKING=y
CONFIG_WLAN_OBJMGR_DEBUG=y
CONFIG_WLAN_OBJMGR_REF_ID_TRACE=y
CONFIG_WLAN_OFFLOAD_PACKETS=y
CONFIG_WLAN_PMO_ENABLE=y
CONFIG_WLAN_POLICY_MGR_ENABLE=y
CONFIG_WLAN_RX_MON_PARSE_CMN_USER_INFO=y
CONFIG_WLAN_SKIP_BAR_UPDATE=y
CONFIG_WLAN_SPECTRAL_ENABLE=y
CONFIG_WLAN_SUPPORT_DATA_STALL=y
CONFIG_WLAN_SYNC_TSF_PLUS=y
CONFIG_WLAN_SYNC_TSF_PLUS_NOIRQ=y
CONFIG_WLAN_SYSFS=y
CONFIG_WLAN_SYSFS_BITRATES=y
CONFIG_WLAN_SYSFS_CHANNEL=y
CONFIG_WLAN_SYSFS_CONNECT_INFO=y
CONFIG_WLAN_SYSFS_DFSNOL=y
CONFIG_WLAN_SYSFS_DP_STATS=y
CONFIG_WLAN_SYSFS_DP_TRACE=y
CONFIG_WLAN_SYSFS_EHT_RATE=y
CONFIG_WLAN_SYSFS_RADAR=y
CONFIG_WLAN_SYSFS_TEMPERATURE=y
CONFIG_WLAN_THERMAL_MULTI_CLIENT_SUPPORT=y
CONFIG_WLAN_TRACEPOINTS=y
CONFIG_WLAN_TRACE_HIDE_MAC_ADDRESS=y
CONFIG_WLAN_TSF_AUTO_REPORT=y
CONFIG_WLAN_TSF_UPLINK_DELAY=y
CONFIG_WLAN_TWT_CONVERGED=y
CONFIG_WLAN_TWT_SAP_PDEV_COUNT=y
CONFIG_WLAN_TWT_SAP_STA_COUNT=y
CONFIG_WLAN_TXRX_FW_STATS=y
CONFIG_WLAN_TXRX_FW_ST_RST=y
CONFIG_WLAN_TXRX_STATS=y
CONFIG_WLAN_TX_FLOW_CONTROL_V2=y
CONFIG_WLAN_UMAC_MLO_MAX_DEV=6
CONFIG_WLAN_VENDOR_HANDOFF_CONTROL=y
CONFIG_WLAN_WBUFF=y
CONFIG_WLAN_WEXT_SUPPORT_ENABLE=y
CONFIG_WMI_BCN_OFFLOAD=y
CONFIG_WMI_CMD_STRINGS=y
CONFIG_WMI_CONCURRENCY_SUPPORT=y
CONFIG_WMI_DBR_SUPPORT=y
CONFIG_WMI_INTERFACE_EVENT_LOGGING=y
CONFIG_WMI_ROAM_SUPPORT=y
CONFIG_WMI_SEND_RECV_QMI=y
CONFIG_WMI_STA_SUPPORT=y
```
