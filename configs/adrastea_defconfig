## configs/adrastea_defconfig
```kconfig
include $(WLAN_ROOT)/configs/default_defconfig

CONFIG_WLAN_DUMP_IN_PROGRESS := y
CONFIG_WLAN_CHIPSET_STATS := y
CONFIG_WLAN_CHIPSET_LOG_MAX_SIZE := y
```

## configs/iq9075_consolidate_fig-v2_defconfig
```kconfig
include $(WLAN_ROOT)/configs/art_consolidate_fig-v2_defconfig

# Not applicable on iq9075
CONFIG_DP_RX_MSDU_DONE_FAILURE_DEBUG=n
CONFIG_QDF_TEST=n
```

## configs/iq9075_gki_fig-v2_defconfig
```kconfig
include $(WLAN_ROOT)/configs/art_gki_fig-v2_defconfig

# iq9075 runs wlan as an out-of-tree module
CONFIG_QCA_CLD_WLAN=m
CONFIG_CNSS_OUT_OF_TREE=y

# explicitly disabled on iq9075
CONFIG_IPA_OFFLOAD=n
CONFIG_IPA_OPT_WIFI_DP=n
CONFIG_IPA_OPT_WIFI_DP_CTRL=n
CONFIG_IPA_OPT_WIFI_DP_LOGGING=n
CONFIG_IPA_WDI3_PENDING_BUFF_REPORT=n
CONFIG_DRIVER_PASSTHRU_MODE=n
CONFIG_WLAN_DP_LOAD_BALANCE_SUPPORT=n
CONFIG_WLAN_DP_FLOW_BALANCE_SUPPORT=n
CONFIG_FEATURE_SMEM_MAILBOX=n

# iq9075-specific additions
QCA_WIFI_FTM_NL80211=y
```

## configs/sa510m.1g_consolidate_qca6490_defconfig
```kconfig
CONFIG_DESC_DUP_DETECT_DEBUG=y
CONFIG_DSC_DEBUG=y
CONFIG_DSC_TEST=y
CONFIG_ENABLE_MTRACE_LOG=y
CONFIG_FEATURE_HTC_CREDIT_HISTORY=y
CONFIG_FEATURE_ROAM_DEBUG=y
CONFIG_HIF_DEBUG=y
CONFIG_QDF_TEST=y
CONFIG_RX_DESC_DEBUG_CHECK=y
CONFIG_TRACE_RECORD_FEATURE=y
CONFIG_UNIT_TEST=y
CONFIG_WLAN_FEATURE_P2P_DEBUG=y
CONFIG_WLAN_NUD_TRACKING=y
```

## configs/sa510m.1g_consolidate_qca6574_defconfig
```kconfig
CONFIG_FEATURE_ROAM_DEBUG=y
CONFIG_FEATURE_HTC_CREDIT_HISTORY=y
CONFIG_TRACE_RECORD_FEATURE=y
CONFIG_WLAN_FEATURE_P2P_DEBUG=y
CONFIG_ENABLE_MTRACE_LOG=y
CONFIG_WLAN_NUD_TRACKING=y
CONFIG_DSC_DEBUG=y
CONFIG_UNIT_TEST=y
CONFIG_DSC_TEST=y
CONFIG_QDF_TEST=y
CONFIG_DESC_DUP_DETECT_DEBUG=y
```

## configs/sa510m_gki_qca6490_defconfig
```kconfig
CONFIG_160MHZ_SUPPORT=y
CONFIG_6G_SCAN_CHAN_SORT_ALGO=y
CONFIG_AGEIE_ON_SCAN_RESULTS=y
CONFIG_ALLOC_CONTIGUOUS_MULTI_PAGE=y
CONFIG_ALLOW_PKT_DROPPING=y
CONFIG_AR900B=y
CONFIG_ATH_11AC_TXCOMPACT=y
CONFIG_ATH_BUS_PM=y
CONFIG_ATH_PERF_PWR_OFFLOAD=y
CONFIG_AUTO_PLATFORM=y
CONFIG_BAND_6GHZ=y
CONFIG_BCN_RATECODE_ENABLE=y
CONFIG_CHECKSUM_OFFLOAD=y
CONFIG_CHIP_VERSION=2
CONFIG_CNSS_UTILS_MODULE=y
CONFIG_CONVERGED_P2P_ENABLE=y
CONFIG_CP_STATS=y
CONFIG_DDP_MON_RSSI_IN_DBM=y
CONFIG_DEBUG_RX_RING_BUFFER=y
CONFIG_DELIVERY_TO_STACK_STATUS_CHECK=y
CONFIG_DESC_TIMESTAMP_DEBUG_INFO=y
CONFIG_DEVICE_FORCE_WAKE_ENABLE=y
CONFIG_DFS_FCC_TYPE4_DURATION_CHECK=y
CONFIG_DISABLE_CHANNEL_LIST=y
CONFIG_DISABLE_EAPOL_INTRABSS_FWD=y
CONFIG_DP_INTR_POLL_BASED=y
CONFIG_DP_IPA_OFFLOAD=y
CONFIG_DP_LFR=y
CONFIG_DP_MEM_PRE_ALLOC=y
CONFIG_DP_MULTIPASS_SUPPORT=y
CONFIG_DP_RX_DROP_RAW_FRM=y
CONFIG_DP_RX_PKT_NO_PEER_DELIVER=y
CONFIG_DP_RX_SPECIAL_FRAME_NEED=y
CONFIG_DP_TRACE=y
CONFIG_DP_TRAFFIC_END_INDICATION=y
CONFIG_DP_TXRX_SOC_ATTACH=y
CONFIG_DP_WAR_VALIDATE_RX_ERR_MSDU_COOKIE=y
CONFIG_DUMP_REO_QUEUE_INFO_IN_DDR=y
CONFIG_DYNAMIC_SINGLE_CHIP="qca6490"
CONFIG_ENABLE_HAL_REG_WR_HISTORY=y
CONFIG_ENABLE_HAL_SOC_STATS=y
CONFIG_ENABLE_SMMU_S1_TRANSLATION=y
CONFIG_ENABLE_VALLOC_REPLACE_MALLOC=y
CONFIG_FEATURE_ACTIVE_TOS=y
CONFIG_FEATURE_ALIGN_STATS_FROM_DP=y
CONFIG_FEATURE_BECN_STATS=y
CONFIG_FEATURE_BSS_TRANSITION=y
CONFIG_FEATURE_COEX=y
CONFIG_FEATURE_CONCURRENCY_MATRIX=y
CONFIG_FEATURE_DELAYED_PEER_OBJ_DESTROY=y
CONFIG_FEATURE_EPPING=y
CONFIG_FEATURE_FORCE_WAKE=y
CONFIG_FEATURE_FW_LOG_PARSING=y
CONFIG_FEATURE_GPIO_CFG=y
CONFIG_FEATURE_HAL_DELAYED_REG_WRITE=y
CONFIG_FEATURE_MONITOR_MODE_SUPPORT=y
CONFIG_FEATURE_NO_DBS_INTRABAND_MCC_SUPPORT=y
CONFIG_FEATURE_OTA_TEST=y
CONFIG_FEATURE_P2P_LISTEN_OFFLOAD=y
CONFIG_FEATURE_PKTLOG=y
CONFIG_FEATURE_RSSI_MONITOR=y
CONFIG_FEATURE_RX_LINKSPEED_ROAM_TRIGGER=y
CONFIG_FEATURE_SAP_COND_CHAN_SWITCH=y
CONFIG_FEATURE_SAR_LIMITS=y
CONFIG_FEATURE_STATION_INFO=y
CONFIG_FEATURE_STATS_EXT_V2=y
CONFIG_FEATURE_STATS_EXT=y
CONFIG_FEATURE_TX_POWER=y
CONFIG_FEATURE_WLAN_AUTO_SHUTDOWN=y
CONFIG_FEATURE_WLAN_CH_AVOID_EXT=y
CONFIG_FEATURE_WLAN_D0WOW=y
CONFIG_FEATURE_WLAN_LPHB=y
CONFIG_FEATURE_WLAN_PRE_CAC=y
CONFIG_FEATURE_WLAN_RA_FILTERING=y
CONFIG_FEATURE_WLAN_SCAN_PNO=y
CONFIG_FEATURE_WLAN_WAPI=y
CONFIG_FIX_TXDMA_LIMITATION=y
CONFIG_FW_THERMAL_THROTTLE=y
CONFIG_GTK_OFFLOAD=y
CONFIG_HAL_DISABLE_NON_BA_2K_JUMP_ERROR=y
CONFIG_HANDLE_RX_REROUTE_ERR=y
CONFIG_HASTINGS_BT_WAR=y
CONFIG_HDD_INIT_WITH_RTNL_LOCK=y
CONFIG_HIF_PCI=y
CONFIG_HIF_REG_WINDOW_SUPPORT=y
CONFIG_HOST_OPCLASS=y
CONFIG_HTT_PADDR64=y
CONFIG_INTRA_BSS_FWD_OFFLOAD=y
CONFIG_IPA_OFFLOAD=y
CONFIG_IPA_P2P_SUPPORT=y
CONFIG_IPA_SET_RESET_TX_DB_PA=y
CONFIG_IPA_WDI_UNIFIED_API=y
CONFIG_LFR_SUBNET_DETECTION=y
CONFIG_LINUX_QCMBR=y
CONFIG_LITHIUM=y
CONFIG_LITTLE_ENDIAN=y
CONFIG_LL_DP_SUPPORT=y
CONFIG_LTE_COEX=y
CONFIG_MARK_ICMP_REQ_TO_FW=y
CONFIG_MAX_ALLOC_PAGE_SIZE=y
CONFIG_MAX_LOGS_PER_SEC=500
CONFIG_MCC_TO_SCC_SWITCH=y
CONFIG_MDM_PLATFORM=y
CONFIG_MON_ENABLE_DROP_FOR_MAC=y
CONFIG_NUM_IPA_IFACE=2
CONFIG_OBSS_PD=y
CONFIG_OFDM_SCRAMBLER_SEED=y
CONFIG_PCI_LINK_STATUS_SANITY=y
CONFIG_PCIE_GEN_SWITCH=y
CONFIG_PEER_PROTECTED_ACCESS=y
CONFIG_PLD_PCIE_CNSS_FLAG=y
CONFIG_PLD_PCIE_INIT_FLAG=y
CONFIG_POWER_MANAGEMENT_OFFLOAD=y
CONFIG_PTT_SOCK_SVC_ENABLE=y
CONFIG_QCA_CLD_WLAN=y
CONFIG_QCA_TARGET_IF_MLME=y
CONFIG_QCA_WIFI_FTM=y
CONFIG_QCA_WIFI_QCA6490=y
CONFIG_QCA_WIFI_QCA8074_VP=y
CONFIG_QCA_WIFI_QCA8074=y
CONFIG_QCA6490_HEADERS_DEF=y
CONFIG_QCACLD_FEATURE_APF=y
CONFIG_QCACLD_FEATURE_BTC_CHAIN_MODE=y
CONFIG_QCACLD_FEATURE_COEX_CONFIG=y
CONFIG_QCACLD_FEATURE_GREEN_AP=y
CONFIG_QCACLD_WLAN_LFR3=y
CONFIG_QCOM_LTE_COEX=y
CONFIG_QCOM_VOWIFI_11R=y
CONFIG_QMI_SUPPORT=y
CONFIG_REG_CLIENT=y
CONFIG_REMOVE_PKT_LOG=y
CONFIG_REO_DESC_DEFER_FREE=y
CONFIG_RX_DEFRAG_DO_NOT_REINJECT=y
CONFIG_RX_DESC_SANITY_WAR=y
CONFIG_RX_FISA=y
CONFIG_RX_OL=y
CONFIG_RX_PERFORMANCE=y
CONFIG_RXDMA_ERR_PKT_DROP=y
CONFIG_SAP_DHCP_FW_IND=y
CONFIG_SCALE_INCLUDES=y
CONFIG_SCHED_HISTORY_SIZE=256
CONFIG_SERIALIZE_QUEUE_SETUP=y
CONFIG_SHADOW_V2=y
CONFIG_SHUTDOWN_WLAN_IN_SYSTEM_SUSPEND=y
CONFIG_SMMU_S1_UNMAP=y
CONFIG_SOFTAP_CHANNEL_RANGE=y
CONFIG_SUPPORT_11AX=y
CONFIG_SUPPORT_P2P_BY_ONE_INTF_WLAN=y
CONFIG_SYSTEM_PM_CHECK=y
CONFIG_TALLOC_DEBUG=y
CONFIG_TARGET_11D_SCAN=y
CONFIG_TARGET_RAMDUMP_AFTER_KERNEL_PANIC=y
CONFIG_TX_AGGREGATION_SIZE_ENABLE=y
CONFIG_TX_MULTI_TCL=y
CONFIG_TX_PER_PDEV_DESC_POOL=y
CONFIG_TX_TID_OVERRIDE=y
CONFIG_WAPI_BIG_ENDIAN=y
CONFIG_WDI_EVENT_ENABLE=y
CONFIG_WDI3_IPA_OVER_GSI=y
CONFIG_WIFI_POS_CONVERGED=y
CONFIG_WINDOW_REG_PLD_LOCK_ENABLE=y
CONFIG_WLAN_CLD_DEV_PM_QOS=y
CONFIG_WLAN_CUSTOM_DSCP_UP_MAP=y
CONFIG_WLAN_DEBUG_CRASH_INJECT=y
CONFIG_WLAN_DEBUG_VERSION=y
CONFIG_WLAN_DEBUGFS=y
CONFIG_WLAN_DFS_MASTER_ENABLE=y
CONFIG_WLAN_DFS_STATIC_MEM_ALLOC=y
CONFIG_WLAN_DIAG_VERSION=y
CONFIG_WLAN_DP_FEATURE_DEFERRED_REO_QDESC_DESTROY=y
CONFIG_WLAN_DYNAMIC_CVM=y
CONFIG_WLAN_FEATURE_11AX=y
CONFIG_WLAN_FEATURE_ACTION_OUI=y
CONFIG_WLAN_FEATURE_DFS_OFFLOAD=y
CONFIG_WLAN_FEATURE_DISA=y
CONFIG_WLAN_FEATURE_DP_BUS_BANDWIDTH=y
CONFIG_WLAN_FEATURE_DP_RX_THREADS=y
CONFIG_WLAN_FEATURE_DYNAMIC_MAC_ADDR_UPDATE=y
CONFIG_WLAN_FEATURE_ELNA=y
CONFIG_WLAN_FEATURE_FILS=y
CONFIG_WLAN_FEATURE_FIPS=y
CONFIG_WLAN_FEATURE_GET_USABLE_CHAN_LIST=y
CONFIG_WLAN_FEATURE_ICMP_OFFLOAD=y
CONFIG_WLAN_FEATURE_LINK_LAYER_STATS=y
CONFIG_WLAN_FEATURE_LRO_CTX_IN_CB=y
CONFIG_WLAN_FEATURE_MARK_FIRST_WAKEUP_PACKET=y
CONFIG_WLAN_FEATURE_MBSSID=y
CONFIG_WLAN_FEATURE_MCC_QUOTA=y
CONFIG_WLAN_FEATURE_MDNS_OFFLOAD=y
CONFIG_WLAN_FEATURE_MEDIUM_ASSESS=y
CONFIG_WLAN_FEATURE_P2P_P2P_STA=y
CONFIG_WLAN_FEATURE_PACKET_FILTERING=y
CONFIG_WLAN_FEATURE_PEER_TXQ_FLUSH_CONF=y
CONFIG_WLAN_FEATURE_RX_SOFTIRQ_TIME_LIMIT=y
CONFIG_WLAN_FEATURE_SAE=y
CONFIG_WLAN_FEATURE_SR=y
CONFIG_WLAN_FEATURE_TWT=y
CONFIG_WLAN_FW_OFFLOAD=y
CONFIG_WLAN_IPA_TX_FLOW_CONTROL=y
CONFIG_WLAN_LOG_DEBUG=y
CONFIG_WLAN_LOG_ENTER=y
CONFIG_WLAN_LOG_ERROR=y
CONFIG_WLAN_LOG_EXIT=y
CONFIG_WLAN_LOG_FATAL=y
CONFIG_WLAN_LOG_INFO=y
CONFIG_WLAN_LOG_WARN=y
CONFIG_WLAN_LOGGING_SOCK_SVC=y
CONFIG_WLAN_NAPI=y
CONFIG_WLAN_NS_OFFLOAD=y
CONFIG_WLAN_OFFLOAD_PACKETS=y
CONFIG_WLAN_OPEN_SOURCE=y
CONFIG_WLAN_PMO_ENABLE=y
CONFIG_WLAN_POLICY_MGR_ENABLE=y
CONFIG_WLAN_SPECTRAL_ENABLE=y
CONFIG_WLAN_SYNC_TSF=y
CONFIG_WLAN_SYSFS_MEM_STATS=y
CONFIG_WLAN_SYSFS=y
CONFIG_WLAN_TWT_CONVERGED=y
CONFIG_WLAN_TWT_SAP_PDEV_COUNT=y
CONFIG_WLAN_TWT_SAP_STA_COUNT=y
CONFIG_WLAN_TX_FLOW_CONTROL_V2=y
CONFIG_WLAN_WOWL_ADD_PTRN=y
CONFIG_WLAN_WOWL_DEL_PTRN=y
CONFIG_WMI_BCN_OFFLOAD=y
CONFIG_WMI_CMD_STRINGS=y
CONFIG_WMI_CONCURRENCY_SUPPORT=y
CONFIG_WMI_INTERFACE_EVENT_LOGGING=y
CONFIG_WMI_ROAM_SUPPORT=y
CONFIG_WMI_STA_SUPPORT=y
```

## configs/sa510m_gki_qca6574_defconfig
```kconfig
CONFIG_QCA_CLD_WLAN=y
CONFIG_LITTLE_ENDIAN=y
CONFIG_DYNAMIC_SINGLE_CHIP="qca6574"
CONFIG_AR6320_SUPPORT=y
CONFIG_HIF_PCI=y
CONFIG_WMI_ROAM_SUPPORT=y
CONFIG_TX_AGGREGATION_SIZE_ENABLE=y
CONFIG_RX_PERFORMANCE=y
CONFIG_DFS_FCC_TYPE4_DURATION_CHECK=y
CONFIG_WLAN_OPEN_SOURCE=y
CONFIG_QCACLD_WLAN_LFR2=y
CONFIG_QCACLD_FEATURE_GREEN_AP=y
CONFIG_QCACLD_FEATURE_APF=y
CONFIG_WLAN_TX_FLOW_CONTROL_LEGACY=y
CONFIG_QCOM_VOWIFI_11R=y
CONFIG_WLAN_FEATURE_ACTION_OUI=y
CONFIG_WLAN_FEATURE_FILS=y
CONFIG_QCOM_LTE_COEX=y
CONFIG_FEATURE_EPPING=y
CONFIG_WLAN_OFFLOAD_PACKETS=y
CONFIG_WLAN_SYNC_TSF=y
CONFIG_WLAN_FEATURE_SAE=y
CONFIG_WLAN_FEATURE_DISA=y
CONFIG_WLAN_FEATURE_FIPS=y
CONFIG_WLAN_NAPI=y
CONFIG_POWER_MANAGEMENT_OFFLOAD=y
CONFIG_LFR_SUBNET_DETECTION=y
CONFIG_MCC_TO_SCC_SWITCH=y
CONFIG_FEATURE_PKTLOG=y
CONFIG_WLAN_DEBUG_CRASH_INJECT=y
CONFIG_WLAN_DEBUGFS=y
CONFIG_WLAN_DEBUG_VERSION=y
CONFIG_WLAN_DIAG_VERSION=y
CONFIG_WLAN_LOG_FATAL=y
CONFIG_WLAN_LOG_ERROR=y
CONFIG_WLAN_LOG_WARN=y
CONFIG_WLAN_LOG_INFO=y
CONFIG_WLAN_LOG_DEBUG=y
CONFIG_WLAN_LOG_ENTER=y
CONFIG_WLAN_LOG_EXIT=y
CONFIG_ATH_PERF_PWR_OFFLOAD=y
CONFIG_REMOVE_PKT_LOG=y
CONFIG_ATH_11AC_TXCOMPACT=y
CONFIG_FEATURE_WLAN_AUTO_SHUTDOWN=y
CONFIG_MDM_PLATFORM=y
CONFIG_ATH_BUS_PM=y
CONFIG_QCA_WIFI_FTM=y
CONFIG_LINUX_QCMBR=y
CONFIG_CHECKSUM_OFFLOAD=y
CONFIG_GTK_OFFLOAD=y
CONFIG_ENABLE_SMMU_S1_TRANSLATION=y
CONFIG_TARGET_RAMDUMP_AFTER_KERNEL_PANIC=y
CONFIG_FEATURE_STATS_EXT=y
CONFIG_WLAN_DFS_STATIC_MEM_ALLOC=y
CONFIG_WLAN_DFS_MASTER_ENABLE=y
CONFIG_DISABLE_CHANNEL_LIST=y
CONFIG_WLAN_DYNAMIC_CVM=y
CONFIG_WIFI_POS_CONVERGED=y
CONFIG_CP_STATS=y
CONFIG_QCA_TARGET_IF_MLME=y
CONFIG_FEATURE_WLAN_WAPI=y
CONFIG_AGEIE_ON_SCAN_RESULTS=y
CONFIG_FEATURE_FW_LOG_PARSING=y
CONFIG_PTT_SOCK_SVC_ENABLE=y
CONFIG_SOFTAP_CHANNEL_RANGE=y
CONFIG_FEATURE_WLAN_SCAN_PNO=y
CONFIG_WLAN_FEATURE_PACKET_FILTERING=y
CONFIG_WLAN_NS_OFFLOAD=y
CONFIG_FEATURE_WLAN_RA_FILTERING=y
CONFIG_FEATURE_WLAN_LPHB=y
CONFIG_WMI_INTERFACE_EVENT_LOGGING=y
CONFIG_WLAN_FEATURE_LINK_LAYER_STATS=y
CONFIG_WMI_BCN_OFFLOAD=y
CONFIG_160MHZ_SUPPORT=y
CONFIG_REG_CLIENT=y
CONFIG_WLAN_PMO_ENABLE=y
CONFIG_CONVERGED_P2P_ENABLE=y
CONFIG_WLAN_POLICY_MGR_ENABLE=y
CONFIG_HDD_INIT_WITH_RTNL_LOCK=y
CONFIG_WLAN_CONV_SPECTRAL_ENABLE=y
CONFIG_WLAN_SPECTRAL_ENABLE=y
CONFIG_WMI_CMD_STRINGS=y
CONFIG_FEATURE_MONITOR_MODE_SUPPORT=y
CONFIG_WLAN_FEATURE_BMI=y
CONFIG_FEATURE_RSSI_MONITOR=y
CONFIG_FEATURE_BSS_TRANSITION=y
CONFIG_FEATURE_STATION_INFO=y
CONFIG_FEATURE_TX_POWER=y
CONFIG_FEATURE_OTA_TEST=y
CONFIG_FEATURE_ACTIVE_TOS=y
CONFIG_FEATURE_SAR_LIMITS=y
CONFIG_FEATURE_CONCURRENCY_MATRIX=y
CONFIG_FEATURE_SAP_COND_CHAN_SWITCH=y
CONFIG_FEATURE_P2P_LISTEN_OFFLOAD=y
CONFIG_WMI_CONCURRENCY_SUPPORT=y
CONFIG_WMI_STA_SUPPORT=y
CONFIG_LTE_COEX=y
CONFIG_FEATURE_DELAYED_PEER_OBJ_DESTROY=y
CONFIG_TARGET_11D_SCAN=y
CONFIG_HOST_OPCLASS=y
CONFIG_DESC_TIMESTAMP_DEBUG_INFO=y
CONFIG_MAX_LOGS_PER_SEC=500
CONFIG_SCHED_HISTORY_SIZE=256
CONFIG_TALLOC_DEBUG=y
CONFIG_FEATURE_MEMDUMP_ENABLE=y
CONFIG_FEATURE_WLAN_D0WOW=y
CONFIG_DEBUG_RX_RING_BUFFER=y
CONFIG_DP_TRACE=y
CONFIG_PLD_PCIE_CNSS_FLAG=y
CONFIG_PLD_PCIE_INIT_FLAG=y
CONFIG_FEATURE_BECN_STATS=y
CONFIG_WLAN_WOWL_ADD_PTRN=y
CONFIG_WLAN_WOWL_DEL_PTRN=y
CONFIG_WLAN_FEATURE_DP_BUS_BANDWIDTH=y
CONFIG_SAP_DHCP_FW_IND=y
CONFIG_WLAN_FW_OFFLOAD=y
CONFIG_WLAN_SYSFS=y
CONFIG_WLAN_SYSFS_MEM_STATS=y
CONFIG_WLAN_FEATURE_GET_USABLE_CHAN_LIST=y
CONFIG_CNSS_UTILS_MODULE=y
CONFIG_FW_THERMAL_THROTTLE=y
CONFIG_ALLOC_CONTIGUOUS_MULTI_PAGE=y
CONFIG_LL_DP_SUPPORT=y
CONFIG_QMI_SUPPORT=y
CONFIG_SMMU_S1_UNMAP=y
CONFIG_ENABLE_VALLOC_REPLACE_MALLOC=y
CONFIG_INTRA_BSS_FWD_OFFLOAD=y
CONFIG_FEATURE_IPA_PIPE_CHANGE_WDI1=y
CONFIG_AR6320_LL_DP_SUPPORT=y
CONFIG_AR6320_MONITOR_MODE=y
CONFIG_WLAN_LOGGING_SOCK_SVC=y
CONFIG_LEGACY_IPA_OFFLOAD=y
CONFIG_NUM_IPA_IFACE=2
CONFIG_AUTO_PLATFORM=y
```

## configs/wcn8750_defconfig
```kconfig
CONFIG_CNSS_WCN8750 := y
CONFIG_BORON := y
CONFIG_WCN8750_HEADERS_DEF := y
CONFIG_QCA_WIFI_WCN8750 := y


#Enable 11BE EHT
CONFIG_WLAN_FEATURE_11BE := y

# Max Sta Vdev Config
CONFIG_CFG_MAX_STA_VDEVS := 4

#Enable 11BE MLO
CONFIG_WLAN_FEATURE_11BE_MLO := y

#BMISS offload max vdev config
CONFIG_CFG_BMISS_OFFLOAD_MAX_VDEV := 4

#Max MLD dev context
CONFIG_WLAN_UMAC_MLO_MAX_DEV := 3

#DP configs
CONFIG_WLAN_DP_DISABLE_TCL_CMD_CRED_SRNG := y
CONFIG_WLAN_DP_DISABLE_TCL_STATUS_SRNG := y

# Enable separate FW image
CONFIG_GET_DRIVER_MODE := n

CONFIG_QCA_SUPPORT_TX_MIN_RATES_FOR_SPECIAL_FRAMES := y

#Enable COEX feature
CONFIG_FEATURE_COEX := y

#Enable DBAM feature
CONFIG_WLAN_FEATURE_COEX_DBAM := y

CONFIG_DP_TRAFFIC_END_INDICATION := y

#Enable Constrained Application Protocol feature
CONFIG_WLAN_FEATURE_COAP := y

CONFIG_HANDLE_RX_REROUTE_ERR := y

#Enable DP Bus Vote
CONFIG_WLAN_FEATURE_DP_BUS_BANDWIDTH := y
CONFIG_FEATURE_BUS_BANDWIDTH_MGR := y
CONFIG_WLAN_CLD_PM_QOS := y
```
