## configs/qca6490_defconfig
```kconfig
CONFIG_CNSS_QCA6490 := y
include $(WLAN_ROOT)/configs/default_defconfig
ifeq ($(CONFIG_WLAN_FOR_AUTO_GVM), y)
CONFIG_HIF_CPU_PERF_AFFINE_MASK := n
endif

ifeq ($(TARGET_BUILD_VARIANT),user)
	PANIC_ON_BUG := n
endif
```
